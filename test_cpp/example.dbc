VERSION ""

NS_ :

BS_:

BU_: PCM

BO_ 255 SpeedMessage: 8 PCM
 SG_ Speed : 0|16@0+ (1,0) [0|65535] ""  PCM

CM_ "Example DBC file for SpeedMessage.";
